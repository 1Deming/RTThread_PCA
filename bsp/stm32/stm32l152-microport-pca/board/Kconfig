## bsp/stm32/stm32l152-microport-pca/board/Kconfig
```kconfig
menu "Hardware Drivers Config"

config SOC_STM32L152VET6
    bool "select MCU ID"
    select RT_USING_COMPONENTS_INIT
    select RT_USING_USER_MAIN
    select SOC_SERIES_STM32L1
    default y

    menu "Onboard Peripheral Drivers"
        
        config BSP_USING_SPI_OLCD
            bool "Enable OLCD"
            select RT_USING_SPI_OLCD            
            default n


    endmenu

    menu "On-chip Peripheral Drivers"

        config BSP_USING_GPIO
            bool "Enable GPIO"
            select RT_USING_PIN
            default y

        menuconfig BSP_USING_UART  
            bool "Enable UART"
            default y
            select RT_USING_SERIAL
            if BSP_USING_UART
                config BSP_USING_UART1
                    bool "Enable UART1"
                    default y

                config BSP_UART1_RX_USING_DMA
                    bool "Enable UART1 RX DMA"
                    depends on BSP_USING_UART1 && RT_SERIAL_USING_DMA
                    default n

                config BSP_USING_UART2
                    bool "Enable UART2"
                    default n

                config BSP_UART2_RX_USING_DMA
                    bool "Enable UART2 RX DMA"
                    depends on BSP_USING_UART2 && RT_SERIAL_USING_DMA
                    default n

            endif

        config BSP_USING_ON_CHIP_FLASH
            bool "Enable on-chip FLASH"
            default n

        menuconfig BSP_USING_SPI
            bool "Enable SPI BUS"
            default n
            select RT_USING_SPI
            if BSP_USING_SPI
                config BSP_USING_SPI1
                    bool "Enable SPI1 BUS"
                    default n

                config BSP_SPI1_TX_USING_DMA
                    bool "Enable SPI1 TX DMA"
                    depends on BSP_USING_SPI1
                    default n
                    
                config BSP_SPI1_RX_USING_DMA
                    bool "Enable SPI1 RX DMA"
                    depends on BSP_USING_SPI1
                    select BSP_SPI1_TX_USING_DMA
                    default n

                config BSP_USING_SPI2
                    bool "Enable SPI2 BUS"
                    default n  
                    
                config BSP_SPI2_TX_USING_DMA
                    bool "Enable SPI2 TX DMA"
                    depends on BSP_USING_SPI2
                    default n
                    
                config BSP_SPI2_RX_USING_DMA
                    bool "Enable SPI2 RX DMA"
                    depends on BSP_USING_SPI2
                    select BSP_SPI2_TX_USING_DMA
                    default n
            endif


        config BSP_USING_QSPI
            bool "Enable QSPI BUS"
            select RT_USING_QSPI
            select RT_USING_SPI
            default n

        config BSP_QSPI_USING_DMA
            bool "Enable QSPI DMA support"
            default n

        menuconfig BSP_USING_TIM
            bool "Enable timer"
            default n
            select RT_USING_HWTIMER
            if BSP_USING_TIM
                config BSP_USING_TIM11
                    bool "Enable TIM11"
                    default n
            endif

        menuconfig BSP_USING_PWM
            bool "Enable pwm"
            default n
            select RT_USING_PWM
            if BSP_USING_PWM
            menuconfig BSP_USING_PWM3
                bool "Enable timer3 output pwm"
                default n
                if BSP_USING_PWM3
                    config BSP_USING_PWM3_CH3
                        bool "Enable PWM3 channel3"
                        default n
                endif
            endif

        menuconfig BSP_USING_ADC
            bool "Enable ADC"
            default n
            select RT_USING_ADC
            if BSP_USING_ADC
                config BSP_USING_ADC1
                    bool "Enable ADC1"
                    default n
            endif

        menuconfig BSP_USING_I2C1
            bool "Enable I2C1 BUS (software simulation)"
            default n
            select RT_USING_I2C
            select RT_USING_I2C_BITOPS
            select RT_USING_PIN
            if BSP_USING_I2C1
                comment "Notice: PB8 --> 24; PB9 --> 25" 
                config BSP_I2C1_SCL_PIN
                    int "I2C1 scl pin number"
                    range 1 176
                    default 24
                config BSP_I2C1_SDA_PIN
                    int "I2C1 sda pin number"
                    range 1 176
                    default 25
            endif

        menuconfig BSP_USING_I2C2
            bool "Enable I2C2 BUS (software simulation)"
            default n
            select RT_USING_I2C
            select RT_USING_I2C_BITOPS
            select RT_USING_PIN
            if BSP_USING_I2C2
                comment "Notice: PH4 --> 116; PH5 --> 117"
                config BSP_I2C2_SCL_PIN
                    int "i2c2 scl pin number"
                    range 1 176
                    default 116
                config BSP_I2C2_SDA_PIN
                    int "I2C2 sda pin number"
                    range 1 176
                    default 117
            endif

        menuconfig BSP_USING_ONCHIP_RTC
            bool "Enable RTC"
            select RT_USING_RTC
            select RT_USING_LIBC
            default n
            if BSP_USING_ONCHIP_RTC
                choice
                    prompt "Select clock source"
                    default BSP_RTC_USING_LSE

                    config BSP_RTC_USING_LSE
                        bool "RTC USING LSE"

                    config BSP_RTC_USING_LSI
                        bool "RTC USING LSI"
                endchoice
            endif

        config BSP_USING_WDT
            bool "Enable Watchdog Timer"
            select RT_USING_WDT
            default n

        config BSP_USING_SDIO
            bool "Enable SDIO"
            select RT_USING_SDIO
            select RT_USING_DFS
            default n

        config BSP_USING_LTDC
            bool "Enable LTDC"
            default n

            
        source "../libraries/HAL_Drivers/Kconfig"
        
    endmenu

    menu "Board extended module Drivers"

    endmenu

endmenu
```

## components/ui/emWin/Kconfig
```kconfig
menu "ui framework"

config RT_USING_EMWIN
    bool "ui framework emWin"
    select RT_USING_SPI_OLCD
    default n

if RT_USING_EMWIN

config EMWIN_USING_OS
    bool "emWin using RTOS"
    default n
   
endif

endmenu
```
